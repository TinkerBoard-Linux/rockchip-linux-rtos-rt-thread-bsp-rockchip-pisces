## applications/Kconfig
```kconfig
menu "Pisces application"

menuconfig RT_USING_OLPC_DEMO
    bool "olpc demo enable"
    default n

if RT_USING_OLPC_DEMO
    config OLPC_APP_SRCSAVER_ENABLE
        bool "olpc screen saver enable"
        default n

    choice
        prompt "olpc functions select"
        default OLPC_APP_CLOCK_ENABLE

        config OLPC_APP_CLOCK_ENABLE
            bool "olpc clock demo select"

        config OLPC_APP_EBOOK_ENABLE
            bool "olpc ebook demo select"

        config OLPC_APP_BLOCK_ENABLE
            bool "olpc block game select"

    endchoice

    if OLPC_APP_CLOCK_ENABLE
        choice
            prompt "olpc clock style select"
            default OLPC_APP_CLOCK_STYLE_ROUND_ARABIC

            config OLPC_APP_CLOCK_STYLE_ROUND_ARABIC
                bool "select round disc with Arabic number"

            config OLPC_APP_CLOCK_STYLE_ROUND_ROMAN332
                bool "select round disc with Roman number base on RGB332"

            config OLPC_APP_CLOCK_STYLE_ROUND_ROMAN565
                bool "select round disc with Roman number base on RGB565"
        endchoice
    endif

    config OLPC_APP_CLOCK_LOOP_LAMP
        bool "olpc clock loop lamp enable"
        depends on OLPC_APP_CLOCK_STYLE_ROUND_ROMAN565
        default n

endif

endmenu
```
